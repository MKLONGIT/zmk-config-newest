#include <mem.h>
#include <nordic/nrf52840.dtsi>

&power {
	reg0: regulator@40000580 {
		compatible = "nordic,nrf52x-regulator-hv";
		reg = <0x40000580 0x1>;
		regulator-name = "REG0";
		status = "disabled";
	};
	reg1: regulator@40000584 {
		compatible = "nordic,nrf52x-regulator-hv";
		reg = <0x40000584 0x1>;
		regulator-name = "REG1";
		status = "disabled";
	};
};
